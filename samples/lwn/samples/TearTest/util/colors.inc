// DO NOT use use "pragma once" - file included multiple times

/*
 * Copyright (c) 2018, LWPU CORPORATION.  All rights reserved.
 *
 * LWPU CORPORATION and its licensors retain all intellectual property
 * and proprietary rights in and to this software, related documentation
 * and any modifications thereto.  Any use, reproduction, disclosure or
 * distribution of this software and related documentation without an express
 * license agreement from LWPU CORPORATION is strictly prohibited.
 */

/* Color definitions, mostly from https://en.wikipedia.org/wiki/Web_colors */

/*    name        red   green   blue  alpha */
COLOR(red,       1.00f, 0.20f, 0.10f, 0.6f)
COLOR(green,     0.00f, 0.80f, 0.40f, 0.6f)
COLOR(blue,      0.20f, 0.40f, 1.00f, 0.6f)
COLOR(gold,      0.90f, 0.80f, 0.00f, 0.6f)

COLOR(purple,    0.50f, 0.00f, 0.50f, 0.6f)
COLOR(cyan,      0.00f, 1.00f, 1.00f, 0.6f)
COLOR(salmon,    0.98f, 0.50f, 0.45f, 0.6f)
COLOR(lime,      0.00f, 1.00f, 0.00f, 0.6f)

COLOR(indigo,    0.29f, 0.00f, 0.51f, 0.6f)
COLOR(gray,      0.50f, 0.50f, 0.50f, 0.6f)
COLOR(silver,    0.75f, 0.75f, 0.75f, 0.6f)
COLOR(white,     1.00f, 1.00f, 1.00f, 0.6f)

COLOR(teal,      0.00f, 0.50f, 0.50f, 0.6f)
COLOR(navy,      0.00f, 0.00f, 0.50f, 0.6f)
COLOR(fuchsia,   1.00f, 0.00f, 1.00f, 0.6f)
COLOR(pink,      1.00f, 0.75f, 0.80f, 0.6f)

COLOR(olive,     0.50f, 0.50f, 0.00f, 0.6f)
COLOR(orange,    1.00f, 0.65f, 0.00f, 0.6f)
COLOR(khaki,     0.94f, 0.90f, 0.55f, 0.6f)
COLOR(yellow,    1.00f, 1.00f, 0.30f, 0.6f)

COLOR(maroon,    0.50f, 0.00f, 0.00f, 0.6f)
COLOR(lavender,  0.90f, 0.90f, 0.98f, 0.6f)
COLOR(palegreen, 0.60f, 0.98f, 0.60f, 0.6f)
COLOR(skyblue,   0.53f, 0.81f, 0.91f, 0.6f)

COLOR(black,     0.0f, 0.0f, 0.0f, 0.6f)
COLOR(selection, 0.2f, 0.6f, 1.0f, 0.6f)
COLOR(darkgray,  0.2f, 0.2f, 0.2f, 0.6f)
