/*
 * Copyright (c) 2018, LWPU CORPORATION.  All rights reserved.
 *
 * LWPU CORPORATION and its licensors retain all intellectual property
 * and proprietary rights in and to this software, related documentation
 * and any modifications thereto.  Any use, reproduction, disclosure or
 * distribution of this software and related documentation without an express
 * license agreement from LWPU CORPORATION is strictly prohibited.
 */

GLPROC(PFNGLGENFRAMEBUFFERSPROC,         glGenFramebuffers);
GLPROC(PFNGLDELETEFRAMEBUFFERSPROC,      glDeleteFramebuffers);
GLPROC(PFNGLBINDFRAMEBUFFERPROC,         glBindFramebuffer);
GLPROC(PFNGLCHECKFRAMEBUFFERSTATUSPROC,  glCheckFramebufferStatus);
GLPROC(PFNGLFRAMEBUFFERTEXTURE2DPROC,    glFramebufferTexture2D);
GLPROC(PFNGLBLITFRAMEBUFFERPROC,         glBlitFramebuffer);
GLPROC(PFNGLTEXIMAGE2DMULTISAMPLEPROC,   glTexImage2DMultisample);
GLPROC(PFNGLDEBUGMESSAGECALLBACKPROC,    glDebugMessageCallback);
GLPROC(PFNGLGENBUFFERSARBPROC,           glGenBuffers);
GLPROC(PFNGLBINDBUFFERARBPROC,           glBindBuffer);
GLPROC(PFNGLBUFFERDATAARBPROC,           glBufferData);
GLPROC(PFNGLDELETEBUFFERSPROC,           glDeleteBuffers);
GLPROC(PFNGLGENQUERIESPROC,              glGenQueries);
GLPROC(PFNGLQUERYCOUNTERPROC,            glQueryCounter);
GLPROC(PFNGLGETQUERYOBJECTUI64VPROC,     glGetQueryObjectui64v);
GLPROC(PFNWGLSWAPINTERVALEXTPROC,        wglSwapIntervalEXT);
GLPROC(PFNGLUSEPROGRAMPROC,              glUseProgram);
GLPROC(PFNGLDRAWARRAYSINSTANCEDPROC,     glDrawArraysInstanced);
GLPROC(PFNGLCREATESHADERPROC,            glCreateShader);
GLPROC(PFNGLDELETESHADERPROC,            glDeleteShader);
GLPROC(PFNGLSHADERSOURCEPROC,            glShaderSource);
GLPROC(PFNGLCOMPILESHADERPROC,           glCompileShader);
GLPROC(PFNGLCREATEPROGRAMPROC,           glCreateProgram);
GLPROC(PFNGLATTACHSHADERPROC,            glAttachShader);
GLPROC(PFNGLLINKPROGRAMPROC,             glLinkProgram);
GLPROC(PFNGLDELETEPROGRAMPROC,           glDeleteProgram);
GLPROC(PFNGLGETSHADERIVPROC,             glGetShaderiv);
GLPROC(PFNGLGETPROGRAMIVARBPROC,         glGetProgramiv);
GLPROC(PFNGLGETSHADERINFOLOGPROC,        glGetShaderInfoLog);
GLPROC(PFNGLGETPROGRAMINFOLOGPROC,       glGetProgramInfoLog);
GLPROC(PFNGLVERTEXATTRIBPOINTERPROC,     glVertexAttribPointer);
GLPROC(PFNGLENABLEVERTEXATTRIBARRAYPROC, glEnableVertexAttribArray);
