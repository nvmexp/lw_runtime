//
//  Copyright (c) 2019 LWPU Corporation.  All rights reserved.
//
//  LWPU Corporation and its licensors retain all intellectual property and proprietary
//  rights in and to this software, related documentation and any modifications thereto.
//  Any use, reproduction, disclosure or distribution of this software and related
//  documentation without an express license agreement from LWPU Corporation is strictly
//  prohibited.
//
//  TO THE MAXIMUM EXTENT PERMITTED BY APPLICABLE LAW, THIS SOFTWARE IS PROVIDED *AS IS*
//  AND LWPU AND ITS SUPPLIERS DISCLAIM ALL WARRANTIES, EITHER EXPRESS OR IMPLIED,
//  INCLUDING, BUT NOT LIMITED TO, IMPLIED WARRANTIES OF MERCHANTABILITY AND FITNESS FOR A
//  PARTICULAR PURPOSE.  IN NO EVENT SHALL LWPU OR ITS SUPPLIERS BE LIABLE FOR ANY
//  SPECIAL, INCIDENTAL, INDIRECT, OR CONSEQUENTIAL DAMAGES WHATSOEVER (INCLUDING, WITHOUT
//  LIMITATION, DAMAGES FOR LOSS OF BUSINESS PROFITS, BUSINESS INTERRUPTION, LOSS OF
//  BUSINESS INFORMATION, OR ANY OTHER PELWNIARY LOSS) ARISING OUT OF THE USE OF OR
//  INABILITY TO USE THIS SOFTWARE, EVEN IF LWPU HAS BEEN ADVISED OF THE POSSIBILITY OF
//  SUCH DAMAGES
//

#include <srcTests.h>

#include <optix_types.h>

#include <exp/context/EncryptionManager.h>
#include <exp/context/ErrorHandling.h>

#include <tuple>
#include <vector>

using namespace testing;
using namespace optix_exp;

namespace {

struct TestEncryptionManager : Test
{
    void setUpPlainText( const char* text )
    {
        m_plainText   = text;
        m_encodedText = EncryptionManager::getEncryptionPrefix() + m_plainText;
    }

    OptixResult decode()
    {
        return EncryptionManager::decode( prodlib::toStringView( m_encodedText ), m_decoded, m_errDetails );
    }

    std::string       m_plainText;
    std::string       m_encodedText;
    std::vector<char> m_decoded;
    ErrorDetails      m_errDetails;
};

}  // namespace

TEST_F( TestEncryptionManager, decode_preserves_content )
{
    setUpPlainText( "Hello, world." );

    EXPECT_EQ( OPTIX_SUCCESS, decode() );

    EXPECT_EQ( m_plainText, std::string( m_decoded.begin(), m_decoded.end() ) );
}

TEST_F( TestEncryptionManager, decode_translates_NUL )
{
    setUpPlainText( "Hello, \1\1world." );
    const std::string expected{"Hello, \0world.", m_plainText.size() - 1};

    EXPECT_EQ( OPTIX_SUCCESS, decode() );

    EXPECT_EQ( expected, std::string( m_decoded.begin(), m_decoded.end() ) );
}

TEST_F( TestEncryptionManager, decode_translates_ctrl_A )
{
    setUpPlainText( "Hello, \1\2world." );

    EXPECT_EQ( OPTIX_SUCCESS, decode() );

    EXPECT_EQ( std::string( "Hello, \1world." ), std::string( m_decoded.begin(), m_decoded.end() ) );
}

TEST_F( TestEncryptionManager, decode_malformed_encoded_nul )
{
    setUpPlainText( "Hello, \1" );

    EXPECT_EQ( OPTIX_ERROR_ILWALID_VALUE, decode() );

    EXPECT_TRUE( m_decoded.empty() );
    EXPECT_THAT( m_errDetails.m_description, HasSubstr( "Encrypted PTX has invalid position of escape character." ) );
}

TEST_F( TestEncryptionManager, decode_malformed_encoded_ctrl_A )
{
    setUpPlainText( "Hello, \1X" );

    EXPECT_EQ( OPTIX_ERROR_ILWALID_VALUE, decode() );

    EXPECT_TRUE( m_decoded.empty() );
    EXPECT_THAT( m_errDetails.m_description, HasSubstr( "Encrypted PTX has invalid escape sequence." ) );
}

// Some PTX code that was encrypted with a certain vendor keys and salts set.
unsigned char preEncryptedPtx[] = {
    0x65, 0x70, 0x74, 0x78, 0x30, 0x30, 0x30, 0x31, 0x04, 0x25, 0x49, 0x57, 0xe7, 0x69, 0xa9, 0x81,
    0x1f, 0x77, 0x94, 0x04, 0x6f, 0x1c, 0x97, 0xa0, 0x79, 0xbe, 0x2e, 0x5c, 0xf0, 0x36, 0xd0, 0x83,
    0x41, 0xd8, 0xa3, 0x95, 0x67, 0x1e, 0x36, 0xf1, 0xc8, 0x0b, 0xbb, 0xcf, 0x92, 0xe7, 0x46, 0xfc,
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    0xa1, 0x41, 0x65, 0x90, 0x92, 0xc9, 0x99
};

const size_t preEncryptedPtxSize = sizeof( preEncryptedPtx ) / sizeof( preEncryptedPtx[0] );
// clang-format on

using GtestParam = std::tuple<bool, unsigned int>;

class TestStreamingDecryption_P : public TestEncryptionManager, public testing::WithParamInterface<GtestParam>
{
  public:
    void SetUp()
    {
        const char* vendorPublicKey = "vendor_public_key";
        //const char* vendorSecretKey = "b71072c8c9f55fcb3dd349e29202c23417200e5c84039eb7e3081cb8199acaa6";
        const char* optixSalt  = "01234567890123456789012345678901";
        const char* vendorSalt = "01234567890123456789012345678901";

        if( std::get<0>( GetParam() ) )
        {
            EXPECT_EQ( OPTIX_SUCCESS, m_encrypter.setOptixSalt( optixSalt, strlen( optixSalt ), m_errDetails ) );
        }
        EXPECT_EQ( OPTIX_SUCCESS, m_encrypter.setVendorSalt( vendorSalt, strlen( vendorSalt ), m_errDetails ) );
        EXPECT_EQ( OPTIX_SUCCESS, m_encrypter.setPublicVendorKey( vendorPublicKey, strlen( vendorPublicKey ), m_errDetails ) );
        if( std::get<0>( GetParam() ) )
        {
            EXPECT_TRUE( m_encrypter.isWeakVariant() );
        }

        m_windowsSize = std::get<1>( GetParam() );
    }
    void TearDown() {}

  protected:
    unsigned int            m_windowsSize;
    optix_exp::ErrorDetails m_errDetails;
    EncryptionManager       m_encrypter;
};

TEST_P( TestStreamingDecryption_P, decode_string_member )
{
    // just for comparison
    std::vector<char> completeDecryptedData;
    EXPECT_EQ( OPTIX_SUCCESS, m_encrypter.decrypt( { (const char*)&preEncryptedPtx[0], preEncryptedPtxSize },
                                                   completeDecryptedData, m_errDetails ) );

    prodlib::StringView encryptedText{ (const char*)&preEncryptedPtx[0], preEncryptedPtxSize };
    EXPECT_TRUE( m_encrypter.hasEncryptionPrefix( encryptedText ) );
    size_t prefixSize = m_encrypter.getEncryptionPrefix().size();
    EXPECT_TRUE( encryptedText.size() > prefixSize );
    encryptedText = prodlib::StringView( (const char*)&preEncryptedPtx[prefixSize], preEncryptedPtxSize - prefixSize );
    std::vector<char> decryptedText;
    // retrieve decodedText of size window_size!
    while( true )
    {
        std::vector<char> decrypted( m_windowsSize, '\0' );
        size_t            consumed;
        size_t            decryptedSize;
        EXPECT_EQ( OPTIX_SUCCESS, m_encrypter.decryptString( encryptedText, decrypted.data(), decryptedSize,
                                                             m_windowsSize, consumed, m_errDetails ) );
        decryptedText.insert( decryptedText.end(), decrypted.begin(), decrypted.begin() + decryptedSize );
        encryptedText = prodlib::StringView( encryptedText.data() + consumed, encryptedText.size() - consumed );
        if( encryptedText.size() <= 0 || consumed == 0 )
        {
            decryptedText.push_back( '\0' );
            break;
        }
    }
    ASSERT_EQ( completeDecryptedData, decryptedText );
}

TEST_P( TestStreamingDecryption_P, decode_string_C_function )
{
    optix_exp::ErrorDetails errDetails;

    // just for comparison
    std::vector<char> completeDecryptedData;
    EXPECT_EQ( OPTIX_SUCCESS, m_encrypter.decrypt( { (const char*)&preEncryptedPtx[0], preEncryptedPtxSize },
                                                   completeDecryptedData, errDetails ) );

    prodlib::StringView encryptedText{ (const char*)&preEncryptedPtx[0], preEncryptedPtxSize };
    EXPECT_TRUE( m_encrypter.hasEncryptionPrefix( encryptedText ) );
    size_t prefixSize = m_encrypter.getEncryptionPrefix().size();
    EXPECT_TRUE( encryptedText.size() > prefixSize );
    encryptedText = prodlib::StringView( (const char*)&preEncryptedPtx[prefixSize], preEncryptedPtxSize - prefixSize );
    std::vector<char> decryptedText;
    // retrieve decodedText of size window_size!
    while( true )
    {
        std::vector<char> decrypted( m_windowsSize, '\0' );
        size_t            consumed;
        size_t            decryptedSize;
        EXPECT_TRUE( decryptString( &m_encrypter, encryptedText.data(), encryptedText.size(), decrypted.data(), &decryptedSize,
                                    std::min( m_windowsSize, static_cast<unsigned int>( encryptedText.size() ) ), &consumed ) );
        decryptedText.insert( decryptedText.end(), decrypted.begin(), decrypted.begin() + decryptedSize );
        encryptedText = prodlib::StringView( encryptedText.data() + consumed,
                                             encryptedText.size() - std::min( consumed, encryptedText.size() ) );
        if( encryptedText.size() <= 0 || consumed == 0 )
        {
            decryptedText.push_back( '\0' );
            break;
        }
    }
    ASSERT_EQ( completeDecryptedData, decryptedText );
}

// Note that a window_size of 1 byte does not work, just from 8 bytes upwards. The encrypted PTX,
// ie preEncryptedPtx, has less than 1024 bytes.
INSTANTIATE_TEST_SUITE_P( CheckDifferentWindowSizesAndEncryptions,
                          TestStreamingDecryption_P,
                          testing::Combine( testing::Bool(), testing::Values( 8, 32, 128, 1024 ) ),
                          []( const testing::TestParamInfo<TestStreamingDecryption_P::ParamType>& info ) {
                              std::string name = "windowSize_";
                              name += std::to_string( std::get<1>( info.param ) );
                              if( std::get<0>( info.param ) )
                                  name += "_strongEncryption";
                              else
                                  name += "_weakEncryption";
                              return name;
                          } );
